## conf/machine/marvell-cn96xx.conf
```bitbake
#@TYPE: Machine
#@NAME: marvell-cn96xx
#@DESCRIPTION: Machine configuration for Marvell CN96xx SoC

# So far there is no "octeontx2" target processor support in gcc
DEFAULTTUNE = "octeontx2"
require conf/machine/include/arm/armv8-2a/tune-octeontx2.inc

MACHINE_FEATURES = "ext3 pci usbhost vfat"

KERNEL_IMAGETYPE = "Image"

SERIAL_CONSOLES ?= "115200;ttyAMA0"
SERIAL_CONSOLES_CHECK ?= "${SERIAL_CONSOLES}"

IMAGE_FSTYPES += "tar.bz2"

MACHINE_EXTRA_RRECOMMENDS = " kernel-modules"
IMAGE_FSTYPES += "tar.bz2 wic wic.bmap"
IMAGE_TYPEDEP_wic = "tar.bz2"
WKS_FILE ?= "cn96xx-sdimage-bootpart.wks"
do_image_wic[depends] += "mtools-native:do_populate_sysroot dosfstools-native:do_populate_sysroot"
IMAGE_INSTALL_append = " kernel-image-image"
IMAGE_BOOT_FILES ?= " Image"

PREFERRED_PROVIDER_virtual/kernel ??= "linux-yocto"
PREFERRED_VERSION_linux-yocto ?= "5.10%"

# For ostree
OSTREE_BOOTLOADER_INCLUDE ?= ""

# No u-boot
OSTREE_SD_UBOOT_WIC1 ?= "part --ondisk mmcblk --fstype=vfat --align 1536 --size 2560K"
OSTREE_SD_BOOT_ALIGN ?= "8192"

INITRAMFS_IMAGE ??= ""
IMAGE_BOOT_FILES_append =  "${@bb.utils.contains('DISTRO_FEATURES', 'ostree', '${INITRAMFS_IMAGE}-${MACHINE}.${INITRAMFS_FSTYPES};initramfs boot.scr boot.itb', '', d)} \
"
OSTREE_KERNEL ?= "Image"
#DEFAULT_DTB ?= "k3-j721e-proc-board-tps65917.dtb"
OSTREE_COPY_IMAGE_BOOT_FILES = "1"
OSTREE_UBOOT_CMD ?= "booti"

# For ustart.img
OSTREE_NETINST_DEV ?= "/dev/mmcblk0,/dev/sda,/dev/vda"
OSTREE_NETINST_ARGS ?= "${OSTREE_CONSOLE} bl=ufsd rdinit=/install instdev=${OSTREE_NETINST_DEV} instname=wrlinux instbr=\$BRANCH insturl=\$URL instab=${OSTREE_USE_AB} instsf=1 instdate=BUILD_DATE"
```

## wic/cn96xx-sdimage-bootpart.wks
```
# short-description: Create SD card image with a boot partition
# long-description: Creates a partitioned SD card image. Boot files
# are located in the first vfat partition.

# Reserve 8M space used by the boot image (SCP, EBF, ATF and u-boot)
part --ondisk mmcblk --fstype=vfat --align 1536 --size 8M
part /boot --source bootimg-partition --ondisk mmcblk --fstype=vfat --label boot --active --align 8192 --size 32M --use-uuid
part / --source rootfs --ondisk mmcblk --fstype=ext4 --label root --align 4 --use-uuid
```
